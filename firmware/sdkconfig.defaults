## firmware/sdkconfig.defaults
```kconfig
# 固件默认配置（ESP-IDF 5.5.3）
# 注意：v1 故意不开 PSRAM —— 170x320 的双缓冲放内部 RAM 足够，省掉 octal/quad PSRAM 配错导致起不来的风险

# flash / 分区
CONFIG_ESPTOOLPY_FLASHSIZE_16MB=y
CONFIG_PARTITION_TABLE_CUSTOM=y
CONFIG_PARTITION_TABLE_CUSTOM_FILENAME="partitions.csv"

# 性能
CONFIG_ESP_DEFAULT_CPU_FREQ_MHZ_240=y
CONFIG_COMPILER_OPTIMIZATION_PERF=y
CONFIG_FREERTOS_HZ=1000

# 日志：控制台走 USB-Serial/JTAG（本板没有外置 USB 转串口）
CONFIG_ESP_CONSOLE_USB_SERIAL_JTAG=y
CONFIG_LOG_DEFAULT_LEVEL_INFO=y

# LVGL 9：配置走 Kconfig（不用 lv_conf.h）
CONFIG_LV_CONF_SKIP=y
CONFIG_LV_COLOR_DEPTH_16=y
CONFIG_LV_MEM_SIZE_KILOBYTES=64
CONFIG_LV_DEF_REFR_PERIOD=30
CONFIG_LV_USE_OBSERVER=y
CONFIG_LV_FONT_MONTSERRAT_14=y
CONFIG_LV_FONT_MONTSERRAT_20=y
CONFIG_LV_FONT_MONTSERRAT_28=y
CONFIG_LV_USE_PERF_MONITOR=n
CONFIG_LV_USE_LOG=n

# 主频够用即可，WiFi 与 LVGL 抢 CPU 时留点余量
CONFIG_ESP_MAIN_TASK_STACK_SIZE=6144
```
